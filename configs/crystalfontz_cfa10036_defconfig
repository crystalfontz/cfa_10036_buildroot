## configs/crystalfontz_cfa10036_defconfig
```kconfig
BR2_arm=y
BR2_arm926t=y
BR2_JLEVEL=4
BR2_TOOLCHAIN_EXTERNAL=y
BR2_TOOLCHAIN_EXTERNAL_CODESOURCERY_ARM201109=y
BR2_TARGET_GENERIC_HOSTNAME="crystalfontz"
BR2_ROOTFS_DEVICE_CREATION_DYNAMIC_DEVTMPFS=y
BR2_TARGET_GENERIC_ROOT_PASSWD="root"
BR2_TARGET_GENERIC_GETTY_PORT="ttyAMA0"
BR2_ROOTFS_POST_BUILD_SCRIPT="board/crystalfontz/cfa-10036/post-build.sh"
BR2_PACKAGE_BUSYBOX_CONFIG="board/crystalfontz/cfa-10036/busybox.config"
BR2_PACKAGE_BUSYBOX_SHOW_OTHERS=y
BR2_PACKAGE_FBV=y
BR2_PACKAGE_FB_TEST_APP=y
BR2_PACKAGE_EVTEST=y
BR2_PACKAGE_FREETYPE=y
BR2_PACKAGE_TSLIB=y
BR2_PACKAGE_DROPBEAR=y
BR2_PACKAGE_GESFTPSERVER=y
BR2_TARGET_BAREBOX=y
BR2_TARGET_BAREBOX_CUSTOM_GIT=y
BR2_TARGET_BAREBOX_CUSTOM_GIT_REPO_URL="git://github.com/crystalfontz/barebox.git"
BR2_TARGET_BAREBOX_CUSTOM_GIT_VERSION="ff9204e2"
BR2_TARGET_BAREBOX_USE_CUSTOM_CONFIG=y
BR2_TARGET_BAREBOX_CUSTOM_CONFIG_FILE="board/crystalfontz/cfa-10036/barebox.config"
BR2_TARGET_BAREBOX_CUSTOM_ENV=y
BR2_TARGET_BAREBOX_CUSTOM_ENV_PATH="board/crystalfontz/cfa-10036/barebox-env"
BR2_TARGET_MXS_BOOTLETS=y
BR2_TARGET_MXS_BOOTLETS_CUSTOM_GIT=y
BR2_TARGET_MXS_BOOTLETS_CUSTOM_GIT_URL="git://github.com/crystalfontz/bootlets.git"
BR2_TARGET_MXS_BOOTLETS_CUSTOM_GIT_VERSION="c347095c5b"
BR2_TARGET_MXS_BOOTLETS_HAS_IVT=y
BR2_TARGET_MXS_BOOTLETS_CUSTOM_BOARD=y
BR2_TARGET_MXS_BOOTLETS_CUSTOM_BOARD_NAME="cfa10036"
BR2_LINUX_KERNEL=y
BR2_LINUX_KERNEL_CUSTOM_GIT=y
BR2_LINUX_KERNEL_CUSTOM_GIT_REPO_URL="git://github.com/crystalfontz/cfa_10036_kernel.git"
BR2_LINUX_KERNEL_CUSTOM_GIT_VERSION="10e4498"
BR2_LINUX_KERNEL_USE_CUSTOM_CONFIG=y
BR2_LINUX_KERNEL_CUSTOM_CONFIG_FILE="board/crystalfontz/cfa-10036/linux.config"
BR2_LINUX_KERNEL_ZIMAGE=y
BR2_LINUX_KERNEL_DTS_SUPPORT=y
BR2_LINUX_KERNEL_INTREE_DTS_NAME="imx28-cfa10036 imx28-cfa10037 imx28-cfa10049 imx28-cfa10055 imx28-cfa10056 imx28-cfa10057 imx28-cfa10058"
BR2_LINUX_KERNEL_INSTALL_TARGET=y
```

## configs/crystalfontz_cfa10049_defconfig
```kconfig
BR2_arm=y
BR2_arm926t=y
BR2_JLEVEL=4
BR2_TOOLCHAIN_EXTERNAL=y
BR2_TARGET_GENERIC_HOSTNAME="crystalfontz"
BR2_ROOTFS_DEVICE_CREATION_DYNAMIC_DEVTMPFS=y
BR2_TARGET_GENERIC_GETTY_PORT="ttyAMA0"
BR2_PACKAGE_BUSYBOX_SHOW_OTHERS=y
BR2_PACKAGE_FBV=y
BR2_PACKAGE_FREETYPE=y
BR2_PACKAGE_TSLIB=y
BR2_PACKAGE_DHCP=y
BR2_PACKAGE_DHCP_CLIENT=y
BR2_TARGET_BAREBOX=y
BR2_TARGET_BAREBOX_CUSTOM_TARBALL=y
BR2_TARGET_BAREBOX_CUSTOM_TARBALL_LOCATION="http://www.barebox.org/download/barebox-2012.09.0.tar.bz2"
BR2_TARGET_BAREBOX_BOARD_DEFCONFIG="cfa10036"
BR2_TARGET_MXS_BOOTLETS=y
BR2_TARGET_MXS_BOOTLETS_CUSTOM_TARBALL=y
BR2_TARGET_MXS_BOOTLETS_CUSTOM_TARBALL_URL="https://github.com/crystalfontz/bootlets/tarball/master/crystalfontz-bootlets-c347095.tar.gz"
BR2_TARGET_MXS_BOOTLETS_HAS_IVT=y
BR2_TARGET_MXS_BOOTLETS_CUSTOM_BOARD=y
BR2_TARGET_MXS_BOOTLETS_CUSTOM_BOARD_NAME="cfa10036"
BR2_LINUX_KERNEL=y
BR2_LINUX_KERNEL_CUSTOM_TARBALL=y
BR2_LINUX_KERNEL_CUSTOM_TARBALL_LOCATION="https://github.com/crystalfontz/cfa_10036_kernel/tarball/cfa-10049-spidev/crystalfontz-cfa_10036_kernel-cfa-10049-spidev.tar.gz"
BR2_LINUX_KERNEL_USE_CUSTOM_CONFIG=y
BR2_LINUX_KERNEL_CUSTOM_CONFIG_FILE="board/crystalfontz/cfa-10049/linux.config"
BR2_LINUX_KERNEL_APPENDED_ZIMAGE=y
BR2_LINUX_KERNEL_INTREE_DTS_NAME="imx28-cfa10049"
BR2_LINUX_KERNEL_INSTALL_TARGET=y
```

## package/network-manager-applet/Config.in
```kconfig
config BR2_PACKAGE_NETWORK_MANAGER_APPLET 
	bool "network-manager-applet" 
	depends on BR2_PACKAGE_NETWORK_MANAGER 
	depends on BR2_PACKAGE_ISO_CODES 
	select BR2_PACKAGE_LIBTASN1 
	select BR2_PACKAGE_GNOME_KEYRING 
	select BR2_PACKAGE_NOTIFICATION_DAEMON 
	select BR2_PACKAGE_CONSOLEKIT 
	help 
	  GTK+ applet for NetworkManager 
 
	  http://projects.gnome.org/NetworkManager/
 
```
